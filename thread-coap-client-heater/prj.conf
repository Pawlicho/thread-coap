## CMakeLists.txt
```
cmake_minimum_required(VERSION 3.20.0)
find_package(Zephyr REQUIRED HINTS $ENV{ZEPHYR_BASE})

project(thread-coap-client)

target_sources(app PRIVATE
    src/main.c
    src/communication/coap/coap_client.c
    src/communication/thread/thread.c
    src/communication/thread/nat64_utils.c
    src/communication/thread/mtd/mtd.c
    src/io/environment.c
    src/io/buttons/buttons.c
    src/io/simulated/regulator/regulator.c
    src/io/simulated/sensor/sensor.c
    src/utils/client_utils.c)

target_include_directories(app PUBLIC
    src/
    src/common
    src/communication/coap
    src/communication/thread
    src/communication/thread/mtd
    src/io
    src/io/buttons
    src/io/simulated/
    src/io/simulated/regulator
    src/io/simulated/sensor
    src/utils)
```

## prj.conf
```kconfig
# GPIO enable
CONFIG_GPIO=y

# nRF board library
CONFIG_DK_LIBRARY=y

# Enable OpenThread features set
CONFIG_OPENTHREAD_NORDIC_LIBRARY_MASTER=y

CONFIG_NET_L2_OPENTHREAD=y

# Generic networking options
CONFIG_NETWORKING=y

# Network shell
CONFIG_SHELL=y
CONFIG_OPENTHREAD_SHELL=y
CONFIG_SHELL_ARGC_MAX=26
CONFIG_SHELL_CMD_BUFF_SIZE=416

CONFIG_MBEDTLS_SHA1_C=n
CONFIG_FPU=y

CONFIG_GPIO_SHELL=y

# Thread Network default parameters
CONFIG_OPENTHREAD_MANUAL_START=y

# Logging
CONFIG_NET_LOG=y
CONFIG_LOG=y
CONFIG_PRINTK=y
CONFIG_LOG_BACKEND_RTT=y
CONFIG_LOG_DEFAULT_LEVEL=3

# Network sockets
CONFIG_NET_SOCKETS=y
CONFIG_NET_SOCKETS_POSIX_NAMES=y
CONFIG_NET_SOCKETS_POLL_MAX=4

# Enable CoAP utils and CoAP protocol
CONFIG_COAP_UTILS=y

# This variant requires increased system workqueue stack size
CONFIG_SYSTEM_WORKQUEUE_STACK_SIZE=2048

# Enable MTD Sleepy End Device
CONFIG_OPENTHREAD_MTD=y
CONFIG_OPENTHREAD_MTD_SED=y
CONFIG_OPENTHREAD_POLL_PERIOD=1000
CONFIG_RAM_POWER_DOWN_LIBRARY=y
CONFIG_PM_DEVICE=y

# Border Router to be able to use nat64
CONFIG_OPENTHREAD_BORDER_ROUTER=y
CONFIG_OPENTHREAD_JOINER_AUTOSTART=y

CONFIG_OPENTHREAD_PANID=65535
```

## src/main.c
```c
#include <zephyr/kernel.h>
#include <dk_buttons_and_leds.h>
#include <zephyr/logging/log.h>

#include "buttons.h"
#include "thread.h"

LOG_MODULE_REGISTER(COAP_CLIENT, CONFIG_LOG_DEFAULT_LEVEL);

static struct openthread_state_changed_cb ot_state_chaged_cb = 
{
    .state_changed_cb = on_thread_state_changed
};

int main(void)
{
    int ret;

	if ( (ret = dk_buttons_init(on_button_changed)) != 0) 
    {
		LOG_ERR("Cannot init buttons (error: %d)", ret);
		return ret;
	}

    if ( (ret = dk_leds_init()) != 0 )
    {
        LOG_ERR("Cannot init leds (error: %d)", ret);
		return ret;
    }

    if ( (ret = openthread_state_changed_cb_register(openthread_get_default_context(), &ot_state_chaged_cb)) != 0)
    {
        LOG_ERR("Unable to set openthread_state_changed_cb_register: %d", ret);
        return ret;
    }

    return 0;
}
```
