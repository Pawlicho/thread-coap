## CMakeLists.txt
```
cmake_minimum_required(VERSION 3.20.0)
find_package(Zephyr REQUIRED HINTS $ENV{ZEPHYR_BASE})

project(thread-coap-client)

target_sources(app PRIVATE
    src/main.c
    src/utils/client_utils.c
    src/coap/coap_client.c
    src/thread/mtd/mtd.c
    src/thread/thread.c
    src/utils/buttons.c
    src/regulator/regulator.c
    src/sensor/sensor.c)

target_include_directories(app PUBLIC
    src/
    src/common
    src/coap
    src/regulator
    src/sensor
    src/thread
    src/thread/mtd
    src/utils)
```

## prj.conf
```kconfig
# GPIO enable
CONFIG_GPIO=y

# nRF board library
CONFIG_DK_LIBRARY=y

# Enable OpenThread features set
CONFIG_OPENTHREAD_NORDIC_LIBRARY_MASTER=y

CONFIG_NET_L2_OPENTHREAD=y

# Generic networking options
CONFIG_NETWORKING=y

# Network shell
CONFIG_SHELL=y
CONFIG_OPENTHREAD_SHELL=y
CONFIG_SHELL_ARGC_MAX=26
CONFIG_SHELL_CMD_BUFF_SIZE=416

CONFIG_MBEDTLS_SHA1_C=n
CONFIG_FPU=y

CONFIG_GPIO_SHELL=y

# Thread Network default parameters
CONFIG_OPENTHREAD_MANUAL_START=n
CONFIG_OPENTHREAD_PANID=11111
CONFIG_OPENTHREAD_CHANNEL=13
CONFIG_OPENTHREAD_NETWORK_NAME="pawel_network"
CONFIG_OPENTHREAD_XPANID="fb:02:00:00:ab:cd:00:00"
CONFIG_OPENTHREAD_NETWORKKEY="00:11:22:33:44:55:66:77:88:99:aa:bb:cc:dd:ee:ff"

# Logging
CONFIG_NET_LOG=y
CONFIG_LOG=y
CONFIG_PRINTK=y
CONFIG_LOG_BACKEND_RTT=y
CONFIG_LOG_DEFAULT_LEVEL=3

# Network sockets
CONFIG_NET_SOCKETS=y
CONFIG_NET_SOCKETS_POSIX_NAMES=y
CONFIG_NET_SOCKETS_POLL_MAX=4

# Enable CoAP utils and CoAP protocol
CONFIG_COAP_UTILS=y

# This variant requires increased system workqueue stack size
CONFIG_SYSTEM_WORKQUEUE_STACK_SIZE=2048

# Enable MTD Sleepy End Device
CONFIG_OPENTHREAD_MTD=y
CONFIG_OPENTHREAD_MTD_SED=y
CONFIG_OPENTHREAD_POLL_PERIOD=3000
CONFIG_RAM_POWER_DOWN_LIBRARY=y
CONFIG_PM_DEVICE=y

# # Enable DTLS
# CONFIG_MBEDTLS_SSL_PROTO_DTLS=y
# CONFIG_NET_SOCKETS_OFFLOAD=y
# CONFIG_NET_SOCKETS_SOCKOPT_TLS=y
# CONFIG_NET_SOCKETS_ENABLE_DTLS=y
```

## src/main.c
```c
#include <zephyr/kernel.h>
#include <dk_buttons_and_leds.h>
#include <zephyr/logging/log.h>

#include "buttons.h"
#include "sensor.h"
#include "regulator.h"

LOG_MODULE_REGISTER(COAP_CLIENT, LOG_LEVEL_DBG);

int main(void)
{
    int ret;

	if ( (ret = dk_buttons_init(on_button_changed)) != 0) 
    {
		LOG_ERR("Cannot init buttons (error: %d)", ret);
		return ret;
	}

    if ( (ret = client_init()) != 0)
    {
        LOG_ERR("Cannot initialize client (error: %d)", ret);
        return ret;
    }

    sensor_init();
    regulator_init();

    return 0;
}
```

## src/buttons.c
```c
#include "buttons.h"

void on_button_changed(uint32_t button_state, uint32_t has_changed)
{
    uint32_t buttons = button_state & has_changed;

	if (buttons & DK_BTN1_MSK) 
    { 
        increase_current_temp();   
	}
    else if (buttons & DK_BTN2_MSK)
    {
        decrease_current_temp();
    }
    else if (buttons & DK_BTN3_MSK)
    {
        updateHeater();
    }
    else if (buttons & DK_BTN4_MSK)
    {
        toggle_minimal_sleepy_end_device();
    }
}
```

## src/client_utils.c
```c
#include "client_utils.h"
#include "coap_client.h"
#include "common.h"
#include "mtd.h"
#include "thread.h"
#include "heater.h"

#include <zephyr/kernel.h>

#define BUTTON_TEMPERATURE_UPDATE_STEP  (5.0f)

LOG_MODULE_DECLARE(COAP_CLIENT);

/* Global var indicating Thread state */
bool is_connected;

volatile HEATER_CONTEXT_T heater = {.current_temp = -11.23f, .correction = 0};

static struct openthread_state_changed_cb ot_state_chaged_cb = 
{
    .state_changed_cb = on_thread_state_changed
};

static void decrease_current_temp_work_cb(struct k_work *item)
{
    heater.current_temp -= BUTTON_TEMPERATURE_UPDATE_STEP;
    LOG_INF("Decreased environment temperature by %.2f. Current temperature: %.2f.",
            BUTTON_TEMPERATURE_UPDATE_STEP,
            heater.current_temp);

}

static void increase_current_temp_work_cb(struct k_work *item)
{
    heater.current_temp += BUTTON_TEMPERATURE_UPDATE_STEP;
    LOG_INF("Increased environment temperature by %.2f. Current temperature: %.2f.",
            BUTTON_TEMPERATURE_UPDATE_STEP,
            heater.current_temp);


}

/* Tasks declaration */
static struct k_work update_heater_work;
static struct k_work toggle_MTD_SED_work;
static struct k_work decrease_current_temp_work;
static struct k_work increase_current_temp_work;

static void submit_work_if_connected(struct k_work *work)
{
	if (is_connected) 
    {
		k_work_submit(work);
	} 
    else 
    {
		LOG_WRN("Thread connection is broken");
	}
}

int client_init()
{
    int err;

    serv_addr_init();
    coap_init(AF_INET6, NULL);

    k_work_init(&update_heater_work, update_heater_work_cb);
    k_work_init(&toggle_MTD_SED_work, toggle_minimal_sleepy_end_device_work_cb);
    k_work_init(&decrease_current_temp_work, decrease_current_temp_work_cb);
    k_work_init(&increase_current_temp_work, increase_current_temp_work_cb);

	if ( (err = openthread_state_changed_cb_register(openthread_get_default_context(), &ot_state_chaged_cb)) != 0)
    {
        LOG_ERR("Unable to set openthread_state_changed_cb_register: %d", err);
        return err;
    }
    else
    if ( (err = openthread_start(openthread_get_default_context())) != 0)
    {
        LOG_ERR("Unable to start Openthread: %d", err);
        return err;
    }

    return 0;
}

/* UI functions */

void updateHeater(void)
{
    submit_work_if_connected(&update_heater_work);
}

void toggle_minimal_sleepy_end_device(void)
{
	k_work_submit(&toggle_MTD_SED_work);
}

void decrease_current_temp(void)
{
    k_work_submit(&decrease_current_temp_work);
}

void increase_current_temp(void)
{
    k_work_submit(&increase_current_temp_work);
}
```

## src/client_utils.h
```c
#pragma once

#include <stdint.h>
#include <stdbool.h>
#include <stdlib.h>

#include <zephyr/logging/log.h>
#include "coap_common.h"

int client_init(void);

void decrease_current_temp(void);

void increase_current_temp(void);

void updateHeater(void);

void toggle_minimal_sleepy_end_device(void);
```

## src/coap_client.c
```c
#include "coap_client.h"
#include "heater.h"

LOG_MODULE_DECLARE(COAP_CLIENT);

/* CoAP resources URIs*/
static const char *const heater_option[]          = { HEATER_URI_PATH,          NULL };

/* CoAP server address structure */
static struct sockaddr_in6 server_addr = {};

void serv_addr_init()
{
    int err;
    server_addr.sin6_family = AF_INET6;
    server_addr.sin6_port = htons(SERVER_PORT);
    err = zsock_inet_pton(AF_INET6, SERVER_IPV6_ADDRESS, &server_addr.sin6_addr);

    __ASSERT(err == 1, "zsock_inet_pton() failed %d", err);
}

int heater_reply(const struct coap_packet *response,
				           struct coap_reply *reply,
				           const struct sockaddr *from)
{
    const uint8_t* payload;
    uint16_t payload_size = RESPONSE_PAYLOAD_SIZE_HEATER;

    ARG_UNUSED(reply);

    struct sockaddr receive = *(from);
    struct sockaddr_in6* rcv_sockaddr = net_sin6(&receive);

    char addr_str[NET_IPV6_ADDR_LEN];
    uint16_t port = ntohs(rcv_sockaddr->sin6_port);

    uint8_t response_code = coap_header_get_code(response);

    if (inet_ntop(AF_INET6, &rcv_sockaddr->sin6_addr, addr_str, sizeof(addr_str)) == NULL) 
    {
        LOG_WRN("Unable to resolve IP address from sockaddr");
    } 

    /*! TODO: Remove magic numbers */
    LOG_INF("Received curr_temp.PUT.Rsp. SRC: %s:%u, CODE: (%d.%02d)",
              addr_str,
              (unsigned int)port,
              (int)(response_code >> 5),
              (int)(response_code & 0x1F));

    payload = coap_packet_get_payload(response, &payload_size);

    if (payload == NULL)
    {
        LOG_ERR("Did not receive data payload from curr_temp.PUT.Rsp. SRC: %s:%u, CODE: (%d.%02d)",
                addr_str,
                (unsigned int)port,
                (int)(response_code >> 5),
                (int)(response_code & 0x1F));
                
        return -EINVAL;
    }

    heater.correction = atof(payload);

    LOG_INF("Received data payload from curr_temp.PUT.Rsp. DATA: %s, SRC: %s:%u, CODE: (%d.%02d)",
            payload,
            addr_str,
            (unsigned int)port,
            (int)(response_code >> 5),
            (int)(response_code & 0x1F));

    return 0;
}

void update_heater_work_cb(struct k_work *item)
{
    ARG_UNUSED(item);

    uint8_t payload[REQUEST_PAYLOAD_SIZE_HEATER];
    uint32_t payload_size = sizeof(payload);

    snprintk(payload, payload_size, TEMPERATURE_FORMAT, heater.current_temp);

    char addr_str[NET_IPV6_ADDR_LEN];
    uint16_t port = ntohs(server_addr.sin6_port);

    if (inet_ntop(AF_INET6, &server_addr.sin6_addr, addr_str, sizeof(addr_str)) != NULL) 
    {
        LOG_INF("Sending curr_temp.PUT.Req. DST: %s:%u",
                addr_str,
                (unsigned int)port);
    } 
    else 
    {
        LOG_WRN("Unable to resolve IP address from sockaddr.");
    }

    coap_send_request(COAP_METHOD_PUT,
                      (const struct sockaddr*)&server_addr,
                      heater_option,
                      payload,
                      payload_size,
                      heater_reply);
}
```

## src/coap_client.h
```c
#pragma once

#include <zephyr/kernel.h>
#include <net/coap_utils.h>
#include <zephyr/logging/log.h>
#include <zephyr/net/openthread.h>
#include <zephyr/net/socket.h>
#include <openthread/thread.h>
#include <zephyr/net/socket.h>

#include "coap_common.h"
#include "common.h"

int hello_world_reply(const struct coap_packet *response,
				       struct coap_reply *reply,
				       const struct sockaddr *from);

int curr_temp_reply(const struct coap_packet *response,
				    struct coap_reply *reply,
				    const struct sockaddr *from);

void hello_world_work_cb(struct k_work *item);

void update_curr_temp_work_cb(struct k_work *item);

void serv_addr_init();
```

## src/coap_common.h
```c
#pragma once

/*! Server Enpoint definitions */

/*! Synthesised IPv4 Address, from: 172.18.0.1 */
/*! Need to find better sollution than static synthesied prefix becouse the prefix apparently changes */
#define SERVER_IPV6_ADDRESS         "fd24:3e2a:982e:2:0:0:ac12:1"
                                     
#define SERVER_PORT                 (8383)

/*! Resources definitions */

#define HEATER_URI_PATH          "heater"

/* Other commons */

#define TEMPERATURE_FORMAT          "%.2f"

/* 1B sign + 2B integer part + 1B dot + 2B fractional part + End sign */
#define ENCODED_TEMPERATUR_MAX_SIZE (8)

/* REQUEST PAYLOAD SIZES */
#define REQUEST_PAYLOAD_SIZE_HEATER          (ENCODED_TEMPERATUR_MAX_SIZE)

/* RESPONSE PAYLOAD SIZES */
#define RESPONSE_PAYLOAD_SIZE_HEATER         (ENCODED_TEMPERATUR_MAX_SIZE)
```

## src/common.h
```c
#pragma once
#include <stdbool.h>

/* Global var indicating Thread state */
extern bool is_connected;

extern volatile float curr_temp;
extern volatile float correction;
```

## src/heater.h
```c
#pragma once

#include <stdint.h>

typedef struct HEATER_CONTEXT
{
    float current_temp;
    float correction;
}HEATER_CONTEXT_T;

extern volatile HEATER_CONTEXT_T heater;
```

## src/mtd.c
```c
#include "mtd.h"

#include <openthread/thread.h>
#include <zephyr/net/openthread.h>

LOG_MODULE_DECLARE(COAP_CLIENT);

static void mtd_mode_toggle(uint32_t med)
{
	const struct device *cons = DEVICE_DT_GET(DT_CHOSEN(zephyr_console));

	if (!device_is_ready(cons)) 
    {
		return;
	}

	if (med) 
    {
		pm_device_action_run(cons, PM_DEVICE_ACTION_RESUME);
	} 
    else 
    {
		pm_device_action_run(cons, PM_DEVICE_ACTION_SUSPEND);
	}
}

void toggle_minimal_sleepy_end_device_work_cb(struct k_work *item)
{
	otError error;
	otLinkModeConfig mode;
	struct openthread_context *context = openthread_get_default_context();

	__ASSERT_NO_MSG(context != NULL);

	openthread_api_mutex_lock(context);
	mode = otThreadGetLinkMode(context->instance);
	mode.mRxOnWhenIdle = !mode.mRxOnWhenIdle;
	error = otThreadSetLinkMode(context->instance, mode);
	openthread_api_mutex_unlock(context);

	if (error != OT_ERROR_NONE) 
    {
		LOG_ERR("Failed to set MLE link mode configuration");
	} 
    else 
    {
		mtd_mode_toggle(mode.mRxOnWhenIdle);
	}
}
```

## src/regulator.c
```c
#include "regulator.h"
#include "client_utils.h"

#include <zephyr/kernel.h>
#include "heater.h"
#include <math.h>

static struct k_timer regulate_timer;

static struct k_work regulate_work;

static void regulate_work_cb(struct k_work *work)
{
    /* Update temperature if correction needed */
    /* Maximum single correction is bounded by REGULATOR_RESOLUTION */
    /* e.g. 0.2 degrees */
    if (fabs(heater.correction) > REGULATOR_RESOLUTION)
    {
        heater.current_temp += heater.correction > 0 ? REGULATOR_RESOLUTION : REGULATOR_RESOLUTION * -1.0f;
    }
    else
    {
        heater.current_temp += heater.correction > 0 ? heater.correction : heater.correction * -1.0f;
    }
}

static void regulate_timer_cb(struct k_timer *timer)
{
    k_work_submit(&regulate_work);
}

void regulator_init()
{
    /* Initialize regulator timer */
    k_timer_init(&regulate_timer, regulate_timer_cb, NULL);

    /* Initialize regulator work */

    /* Start regulator timer */

    /* Every 100ms update temperature by 0.20 if needed */
    k_timer_start(&regulate_timer, K_MSEC(1333), K_MSEC(1333));

    return 0;
}
```

## src/regulator.h
```c
#pragma once

#define REGULATOR_RESOLUTION    (0.20f)

void regulator_init();
```

## src/sensor.c
```c
#include "sensor.h"
#include "client_utils.h"

#include <zephyr/kernel.h>

static struct k_timer measure_timer;

/* Simulated */
static int debug;

static void measure_timer_cb(struct k_timer *dummy)
{
    updateHeater();
}

void sensor_init()
{
    /* Initialize Timers */
    k_timer_init(&measure_timer,  measure_timer_cb,  NULL);

    /* Start timers */

    /* Every one second send measurement to the Server */
    k_timer_start(&measure_timer, K_MSEC(6 * 333), K_MSEC(6 * 333));
}
```
